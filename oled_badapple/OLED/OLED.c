#include "OLED.h"
#include <string.h>
static uint8_t OLED_GRAM[8][128];

HAL_StatusTypeDef OLED_WriteCommand(uint8_t cmd)
{
	uint8_t buf[2]={OLED_CMD,cmd};
	return HAL_I2C_Master_Transmit(&hi2c1,OLED_ADDR,buf,2,100);
}

void OLED_WriteData(uint8_t data)
{
	uint8_t buf[2]={OLED_DATA,data};
	HAL_I2C_Master_Transmit(&hi2c1,OLED_ADDR,buf,2,100);
}

void OLED_Init(void)
{
    HAL_Delay(100);   // 上电等待

    OLED_WriteCommand(0xAE);	//关闭显示
	
	OLED_WriteCommand(0xD5);	//设置显示时钟分频比/振荡器频率
	OLED_WriteCommand(0x80);
	
	OLED_WriteCommand(0xA8);	//设置多路复用率
	OLED_WriteCommand(0x3F);
	
	OLED_WriteCommand(0xD3);	//设置显示偏移
	OLED_WriteCommand(0x00);
	
	OLED_WriteCommand(0x40);	//设置显示开始行
	
	OLED_WriteCommand(0xA1);	//设置左右方向，0xA1正常 0xA0左右反置
	
	OLED_WriteCommand(0xC8);	//设置上下方向，0xC8正常 0xC0上下反置

	OLED_WriteCommand(0xDA);	//设置COM引脚硬件配置
	OLED_WriteCommand(0x12);
	
	OLED_WriteCommand(0x81);	//设置对比度控制
	OLED_WriteCommand(0xCF);

	OLED_WriteCommand(0xD9);	//设置预充电周期
	OLED_WriteCommand(0xF1);

	OLED_WriteCommand(0xDB);	//设置VCOMH取消选择级别
	OLED_WriteCommand(0x30);

	OLED_WriteCommand(0xA4);	//设置整个显示打开/关闭

	OLED_WriteCommand(0xA6);	//设置正常/倒转显示

	OLED_WriteCommand(0x8D);	//设置充电泵
	OLED_WriteCommand(0x14);

	OLED_WriteCommand(0xAF);	//开启显示

    OLED_Clear();
}

void OLED_SetCursor(uint8_t page, uint8_t col)
{
	OLED_WriteCommand(0xB0 + page);              // 设置页地址
    OLED_WriteCommand(0x00 + (col & 0x0F));      // 列低 4 位
    OLED_WriteCommand(0x10 + ((col >> 4) & 0x0F)); // 列高 4 位
}

void OLED_Lamp(void)
{
	OLED_WriteCommand(0xA5);
}

void OLED_Clear(void)
{
    for (uint8_t page = 0; page < 8; page++)
		for (uint8_t col = 0; col < 128; col++)
            OLED_GRAM[page][col] = 0x00;
	OLED_Refresh();
}

void OLED_DrawPixel(uint8_t x,uint8_t y)
{
	if(x>=128 || y>=64)
	{
		return;
	}
	uint8_t page=y/8;
	uint8_t bit=y%8;
	OLED_GRAM[page][x] |= (1<<bit);
}

void OLED_ClearPixel(uint8_t x, uint8_t y)
{
    if (x >= 128 || y >= 64) return;

    uint8_t page = y / 8;
    uint8_t bit  = y % 8;

    OLED_GRAM[page][x] &= ~(1 << bit);
}

void OLED_Refresh(void)
{
	for(uint8_t page=0;page<8;page++)
	{
		OLED_SetCursor(page,0);
		for(uint8_t col=0;col<128;col++)
		{
			OLED_WriteData(OLED_GRAM[page][col]);
		}
	}
}

void OLED_badapple(void)
{
	OLED_Clear();
	const uint8_t img[8][128]=
{{0x00,0x00,0x00,0x00,0x00,0x00,0x00,0x00,0x00,0x00,0x00,0x00,0x00,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0x00,
0x00,0x00,0x00,0x00,0x80,0xC0,0xC0,0xE0,0xE7,0xFF,0xFF,0xFF,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0x00,0x00},
{0x00,0x00,0x00,0x00,0x00,0x00,0x00,0x00,0x00,0x00,0x00,0x00,0x00,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0xF0,
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0xFF,0xFF,0xFF,0xFF,0xFF,0xFF,0xFF,0xFF,0xFF,0xFF,0xFF,0xFF,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0x00,0x00}};
	memcpy(OLED_GRAM,img,sizeof(img));
	OLED_Refresh();
}

