#include "OLED.h"
#include <string.h>
#include <stdlib.h>
static uint8_t OLED_GRAM[8][128];

HAL_StatusTypeDef OLED_WriteCommand(uint8_t cmd)
{
	uint8_t buf[2]={OLED_CMD,cmd};
	return HAL_I2C_Master_Transmit(&hi2c1,OLED_ADDR,buf,2,100);
}

void OLED_WriteData(uint8_t data)
{
	uint8_t buf[2]={OLED_DATA,data};
	HAL_I2C_Master_Transmit(&hi2c1,OLED_ADDR,buf,2,100);
}

void OLED_Init(void)
{
    HAL_Delay(100);   // 上电等待

    OLED_WriteCommand(0xAE);	//关闭显示
	
	OLED_WriteCommand(0xD5);	//设置显示时钟分频比/振荡器频率
	OLED_WriteCommand(0x80);
	
	OLED_WriteCommand(0xA8);	//设置多路复用率
	OLED_WriteCommand(0x3F);
	
	OLED_WriteCommand(0xD3);	//设置显示偏移
	OLED_WriteCommand(0x00);
	
	OLED_WriteCommand(0x40);	//设置显示开始行
	
	OLED_WriteCommand(0xA1);	//设置左右方向，0xA1正常 0xA0左右反置
	
	OLED_WriteCommand(0xC8);	//设置上下方向，0xC8正常 0xC0上下反置

	OLED_WriteCommand(0xDA);	//设置COM引脚硬件配置
	OLED_WriteCommand(0x12);
	
	OLED_WriteCommand(0x81);	//设置对比度控制
	OLED_WriteCommand(0xCF);

	OLED_WriteCommand(0xD9);	//设置预充电周期
	OLED_WriteCommand(0xF1);

	OLED_WriteCommand(0xDB);	//设置VCOMH取消选择级别
	OLED_WriteCommand(0x30);

	OLED_WriteCommand(0xA4);	//设置整个显示打开/关闭

	OLED_WriteCommand(0xA6);	//设置正常/倒转显示

	OLED_WriteCommand(0x8D);	//设置充电泵
	OLED_WriteCommand(0x14);

	OLED_WriteCommand(0xAF);	//开启显示

    OLED_Clear();
}

void OLED_SetCursor(uint8_t page, uint8_t col)
{
	OLED_WriteCommand(0xB0 + page);              // 设置页地址
    OLED_WriteCommand(0x00 + (col & 0x0F));      // 列低 4 位
    OLED_WriteCommand(0x10 + ((col >> 4) & 0x0F)); // 列高 4 位
}

void OLED_Lamp(void)
{
	OLED_WriteCommand(0xA5);
}

void OLED_Clear(void)
{
    for (uint8_t page = 0; page < 8; page++)
		for (uint8_t col = 0; col < 128; col++)
            OLED_GRAM[page][col] = 0x00;
	OLED_Refresh();
}

void OLED_DrawPixel(uint8_t x,uint8_t y)
{
	if(x>=128 || y>=64)
	{
		return;
	}
	uint8_t page=y/8;
	uint8_t bit=y%8;
	OLED_GRAM[page][x] |= (1<<bit);
}

void OLED_ClearPixel(uint8_t x, uint8_t y)
{
    if (x >= 128 || y >= 64) return;

    uint8_t page = y / 8;
    uint8_t bit  = y % 8;

    OLED_GRAM[page][x] &= ~(1 << bit);
}

void OLED_Refresh(void)
{
	static uint8_t cmd[4] = { OLED_CMD, 0xB0, 0x00, 0x10 };
    HAL_I2C_Master_Transmit(&hi2c1, OLED_ADDR, cmd, sizeof(cmd), 100);
	
	for(uint8_t page=0;page<8;page++)
	{
		OLED_SetCursor(page,0);
		static uint8_t buf[1+128];
		buf[0]=OLED_DATA;
		memcpy(&buf[1],OLED_GRAM[page],128);
		HAL_I2C_Master_Transmit(&hi2c1,OLED_ADDR,buf,129,100);
	}
//	for(uint8_t page=0;page<8;page++)
//	{
//		OLED_SetCursor(page,0);
//		for(uint8_t col=0;col<128;col++)
//		{
//			OLED_WriteData(OLED_GRAM[page][col]);
//		}
//	}
}

void OLED_badapple(void)
{
	OLED_Clear();
	const uint8_t img[8][128]=
{{0x00,0x00,0x00,0x00,0x00,0x00,0x00,0x00,0x00,0x00,0x00,0x00,0x00,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0x00,
0x00,0x00,0x00,0x00,0x80,0xC0,0xC0,0xE0,0xE7,0xFF,0xFF,0xFF,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0x00,0x00},
{0x00,0x00,0x00,0x00,0x00,0x00,0x00,0x00,0x00,0x00,0x00,0x00,0x00,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0xF0,
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0xFF,0xFF,0xFF,0xFF,0xFF,0xFF,0xFF,0xFF,0xFF,0xFF,0xFF,0xFF,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0x00,0x00}};
	memcpy(OLED_GRAM,img,sizeof(img));
	OLED_Refresh();
}

void OLED_DrawCar(uint8_t x, uint8_t y,uint8_t direction)
{
	OLED_DrawPixel(x,y);
	
	OLED_DrawPixel(x-1,y);//middle
	OLED_DrawPixel(x-2,y);
	OLED_DrawPixel(x-3,y);
	OLED_DrawPixel(x-4,y);
	OLED_DrawPixel(x+1,y);
	OLED_DrawPixel(x+2,y);
	OLED_DrawPixel(x+3,y);
	OLED_DrawPixel(x+4,y);
	
	OLED_DrawPixel(x,y-1);
	OLED_DrawPixel(x,y-2);
	OLED_DrawPixel(x,y-3);
	OLED_DrawPixel(x,y-4);
	OLED_DrawPixel(x,y+1);
	OLED_DrawPixel(x,y+2);
	OLED_DrawPixel(x,y+3);
	OLED_DrawPixel(x,y+4);

	switch(direction)
	{
		case('W'):
		{
			OLED_DrawPixel(x,y-7);
			OLED_DrawPixel(x,y-8);
			OLED_DrawPixel(x-1,y-7);
			OLED_DrawPixel(x+1,y-7);
			break;
		}
		case('A'):
		{
			OLED_DrawPixel(x-7,y+1);
			OLED_DrawPixel(x-7,y-1);
			OLED_DrawPixel(x-7,y);
			OLED_DrawPixel(x-8,y);
			break;
		}
		case('S'):
		{
			OLED_DrawPixel(x,y+7);
			OLED_DrawPixel(x,y+8);
			OLED_DrawPixel(x-1,y+7);
			OLED_DrawPixel(x+1,y+7);
			break;
		}
		case('D'):
		{
			OLED_DrawPixel(x+7,y+1);
			OLED_DrawPixel(x+7,y-1);
			OLED_DrawPixel(x+7,y);
			OLED_DrawPixel(x+8,y);
			break;
		}
	}
}

void OLED_DrawLine(uint8_t pos1[2], uint8_t pos2[2])//ai写的
{
    int x0 = pos1[0];
    int y0 = pos1[1];
    int x1 = pos2[0];
    int y1 = pos2[1];

    int dx = x1 - x0;
    int dy = y1 - y0;

    // x 方向环形处理：选择较短的路径
    if (dx > 128 / 2) {
        dx -= 128;
    } else if (dx < -(128 / 2)) {
        dx += 128;
    }

    // y 方向环形处理：选择较短的路径
    if (dy > 64 / 2) {
        dy -= 64;
    } else if (dy < -(64 / 2)) {
        dy += 64;
    }

    // 步数取 |dx| 和 |dy| 的较大值，保证每个方向步进不超过 1 像素
    int steps = (abs(dx) > abs(dy)) ? abs(dx) : abs(dy);
    if (steps == 0) {
        OLED_DrawPixel((uint8_t)x0, (uint8_t)y0);
        return;
    }

    for (int i = 0; i <= steps; i++) {
        // 线性插值
        int x = x0 + (dx * i) / steps;
        int y = y0 + (dy * i) / steps;

        // x 环形映射回 0~127
        x %= 128;
        if (x < 0) x += 128;

        // y 环形映射回 0~63
        y %= 64;
        if (y < 0) y += 64;

        OLED_DrawPixel((uint8_t)x, (uint8_t)y);
    }
}

void OLED_DrawPath(uint8_t previous[10][2])
{
	uint8_t i,j;
	for(i=0;i<9;i++)
	{
		OLED_DrawPixel(previous[i][0],previous[i][1]);
		if(i<8)
		{
			OLED_DrawLine(previous[i],previous[i+1]);
		}
	}
}


